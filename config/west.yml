## config/west.yml
```yaml
manifest:
  remotes:    
    - name: zmkfirmware
      url-base: https://github.com/zmkfirmware
    - name: aroum
      url-base: https://github.com/aroum
  projects:
    - name: zmk
      remote: aroum
      revision: main
      import: app/west.yml
  self:
    path: config
```
